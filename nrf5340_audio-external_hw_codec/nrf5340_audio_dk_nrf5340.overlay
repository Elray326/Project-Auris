&pinctrl {
    i2s0_default {
	    group1 {
	        psels = <NRF_PSEL(I2S_SCK_M, 1, 12)>, <NRF_PSEL(I2S_SDOUT, 0, 13)>, <NRF_PSEL(I2S_LRCK_M, 0, 16)>;
        };
        group2 {
            psels = <NRF_PSEL(I2S_SCK_M, 1, 12)>, <NRF_PSEL(I2S_SDOUT, 0, 13)>, <NRF_PSEL(I2S_LRCK_M, 0, 16)>;
        };
    };
};