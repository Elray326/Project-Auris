## nrf5340_audio-external_hw_codec/build_1/Kconfig/Kconfig.shield
```kconfig
osource "c:/Users/elray/Documents/humerus/Haptic/boards/shields/*/Kconfig.shield"
osource "C:/ncs/v2.2.0/nrf/boards/shields/*/Kconfig.shield"
```
